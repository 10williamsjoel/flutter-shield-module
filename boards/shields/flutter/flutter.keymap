#include <behaviors.dtsi>
#include <dt-bindings/zmk/keys.h>
#include <dt-bingings/zmk/bt.h>
#include <dt-bindings/zmk/outputs.h>

/ {
    keymap {
        compatible = "zmk,keymap";

        default_layer {
            bindings = <
            &kp A   &bt BT_SEL 0   &kp C   &bt BT_SEL 1   &kp E   &bt BT_SEL 2   &out OUT_BLE    &bt BT_SEL 3   &bt BT_CLR   &kp J   &kp K   &kp L &kp M &kp N &kp O &kp P &kp Q &kp R
            >;
        };
    };

};
